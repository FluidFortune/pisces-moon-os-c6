## sdkconfig.defaults
```kconfig
# Pisces Moon OS — Ghost Engine sdkconfig defaults (ESP32-C6)
# AGPL-3.0-or-later / fluidfortune.com

CONFIG_IDF_TARGET="esp32c6"
CONFIG_FREERTOS_HZ=1000

# Console/log
CONFIG_LOG_DEFAULT_LEVEL_INFO=y
CONFIG_ESP_CONSOLE_USB_SERIAL_JTAG=y

# WiFi
CONFIG_ESP_WIFI_ENABLED=y
CONFIG_ESP_WIFI_TX_BUFFER_TYPE=1
CONFIG_ESP_WIFI_DYNAMIC_TX_BUFFER_NUM=32

# BLE (NimBLE)
CONFIG_BT_ENABLED=y
CONFIG_BT_NIMBLE_ENABLED=y
CONFIG_BT_NIMBLE_ROLE_CENTRAL=y
CONFIG_BT_NIMBLE_ROLE_PERIPHERAL=y
CONFIG_BT_NIMBLE_ROLE_OBSERVER=y
CONFIG_BT_NIMBLE_ROLE_BROADCASTER=y
CONFIG_BT_NIMBLE_HCI_UART=n

# HTTPS — bundle root CAs
CONFIG_MBEDTLS_CERTIFICATE_BUNDLE=y
CONFIG_MBEDTLS_CERTIFICATE_BUNDLE_DEFAULT_FULL=y

# Heap
CONFIG_ESP_TASK_WDT_TIMEOUT_S=10

# Stack sizes for our tasks
CONFIG_ESP_MAIN_TASK_STACK_SIZE=4096
```
